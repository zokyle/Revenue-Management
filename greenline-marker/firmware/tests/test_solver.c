/*
 * test_solver.c - the ported estimator and aim solver against the Python
 * reference, in BOTH precisions.
 *
 *   double build (gl_vec64_*, core compiled with -DGL_SOLVER_DOUBLE)
 *       must reproduce every reference vector within the tolerance that
 *       sim/results/REFERENCE_VECTORS.md states ("How to compare");
 *   single build (gl_vec32_*, the firmware's arithmetic)
 *       cannot reach those tolerances.  It runs with the firmware's own
 *       default tolerances; its deviation from the reference is MEASURED on
 *       every vector in the units that matter and the measured bounds are
 *       asserted with a modest margin.
 *
 * The vectors (tests/solver/gl_solver_vectors.c) are generated by
 * tools/gen_vectors.py from sim/results/reference_vectors.json: 240 + 120
 * simulated reads and solver cases, and the appended fallback / status /
 * roll groups, which between them reach every aim_source and every solve
 * status.  Also here: hostile inputs (every call must return a defined
 * status and finite or explicitly flagged outputs; this test runs under the
 * address and undefined-behaviour sanitisers in `make asan`) and the bounds
 * on trial rolls and RK4 steps.
 */
#include <stdlib.h>

#include "gl_config.h"
#include "gl_solver.h"
#include "gl_solver_run.h"
#include "gl_test.h"

#define PI 3.14159265358979323846
/** A YARDSTICK, not the resolution of the firmware's line: the step in which
 * the reference's Monte Carlo quantises the displayed aim (2 / 122 rad = 0.94
 * degree, one pixel at the rim of the aperture; sim/greenline_sim/
 * montecarlo.py).  The firmware's dithered line reproduces an aim to 0.05
 * degree rms (tests/test_gfx.c, README "Display"). */
#define DISPLAY_STEP_MRAD (0.94 * PI / 180.0 * 1e3)
#define CUP_M 0.10795

/* gl_status_t values used here (gl_types.h) */
#define ST_OK 0

static const char *const STATUS_NAME[6] = { "OK",         "PACE_LIMITED",   "UNREACHABLE",
                                            "NO_BRACKET", "NO_CONVERGENCE", "INVALID" };

/* ---- the comparison rule of REFERENCE_VECTORS.md ------------------------------- */

static double angle_diff(double a, double b)
{
    double d = fmod(a - b, 2.0 * PI);
    if (d < 0.0) {
        d += 2.0 * PI;
    }
    return (d > PI) ? (2.0 * PI - d) : d;
}

/**
 * |c - ref| in units of the allowed difference max(1e-4 |ref|, floor):
 * <= 1 passes.  Two not-a-numbers agree, one does not.  *abs_diff (may be
 * NULL) receives |c - ref|.
 */
static double excess(double c, double ref, double floor_abs, int is_angle, double *abs_diff)
{
    double d, allowed;
    if (abs_diff != NULL) {
        *abs_diff = 0.0;
    }
    if (isnan(c) || isnan(ref)) {
        return (isnan(c) && isnan(ref)) ? 0.0 : (double)INFINITY;
    }
    d = is_angle ? angle_diff(c, ref) : fabs(c - ref);
    if (abs_diff != NULL) {
        *abs_diff = d;
    }
    if (d == 0.0) {
        return 0.0;
    }
    allowed = 1e-4 * fabs(ref);
    if (floor_abs > allowed) {
        allowed = floor_abs;
    }
    return (allowed > 0.0) ? (d / allowed) : (double)INFINITY;
}

/** Per-field maximum differences of a group of estimator cases. */
enum {
    F_PHI, F_AIM, F_V0, F_PLAYS, F_BREAK_M, F_BREAK_CUPS, F_DISTANCE, F_DIST_SIGMA, F_BEARING,
    F_SLOPE, F_FALL, F_DZ, F_CROSS_SIGMA, F_CONF, F_A_R, F_GRAIN, F_PATCH_AB, F_PATCH_CDE,
    F_LEVEL, F_TILT, F_STATION, F_RANGE, F_COST, F_COUNT
};
static const char *const FIELD_NAME[F_COUNT] = {
    "phi [rad]", "aim_azimuth_device [rad]", "v0 [m/s]", "plays_like [m]", "break_m [m]",
    "break_cups", "distance [m]", "distance_sigma [m]", "bearing [rad]", "slope_pct",
    "fall_line_azimuth [rad]", "dz_hole [m]", "cross_slope_sigma", "confidence", "a_r [m/s^2]",
    "grain", "patch a, b", "patch c, d, e [1/m]", "level_offsets [rad]", "tilt_slopes",
    "stations [m]", "range stereo / mono [m]", "fit_cost"
};

typedef struct {
    double worst;            /* largest excess of the case */
    int worst_field;
    double diff[F_COUNT];    /* largest |difference| per field */
    int flags_equal;
} est_cmp_t;

static void note_(est_cmp_t *cmp, int field, double c, double ref, double floor_abs, int is_angle)
{
    double d;
    const double ex = excess(c, ref, floor_abs, is_angle, &d);
    if (d > cmp->diff[field]) {
        cmp->diff[field] = d;
    }
    if (ex > cmp->worst) {
        cmp->worst = ex;
        cmp->worst_field = field;
    }
}

static int flags_equal_(const gl_vec_est_result_t *r, const gl_vec_expected_t *e)
{
    return r->base_hidden == e->base_hidden && r->flag_missing == e->flag_missing &&
           r->range_missing == e->range_missing && r->poor_horizon == e->poor_horizon &&
           r->used_horizon == e->used_horizon && r->fit_converged == e->fit_converged &&
           r->aim_source == e->aim_source && r->solve_status == e->solve_status &&
           r->fit_starts == e->fit_starts && r->n_stations == e->n_stations;
}

/**
 * Compare one result with the expected record.  `with_aim`: also the
 * outputs of the aim solve (not for the best iterate of a failed solve,
 * which depends on the iteration path).
 */
static void compare_estimate_(const gl_vec_est_case_t *c, const gl_vec_est_result_t *r, int with_aim,
                              est_cmp_t *cmp)
{
    const gl_vec_expected_t *e = &c->exp;
    const int straight = (c->method == 3u);
    memset(cmp, 0, sizeof(*cmp));
    cmp->worst_field = -1;
    cmp->flags_equal = flags_equal_(r, e);
    if (with_aim) {
        note_(cmp, F_PHI, r->phi, e->phi, 1e-6, 1);
        note_(cmp, F_AIM, r->aim_azimuth_device, e->aim_azimuth_device, 1e-6, 1);
        note_(cmp, F_V0, r->v0, e->v0, 0.0, 0);
        note_(cmp, F_PLAYS, r->plays_like, e->plays_like, 0.0, 0);
        note_(cmp, F_BREAK_M, r->break_m, e->break_m, 1e-6, 0);
        note_(cmp, F_BREAK_CUPS, r->break_cups, e->break_cups, 1e-5, 0);
    }
    note_(cmp, F_DISTANCE, r->distance, e->distance, 0.0, 0);
    note_(cmp, F_DIST_SIGMA, r->distance_sigma, e->distance_sigma, 0.0, 0);
    note_(cmp, F_BEARING, r->bearing, e->bearing, 1e-6, 1);
    note_(cmp, F_SLOPE, r->slope_pct, e->slope_pct, 0.0, 0);
    if (e->slope_pct > 0.01) {
        note_(cmp, F_FALL, r->fall_line_azimuth, e->fall_line_azimuth, 1e-6, 1);
    }
    note_(cmp, F_DZ, r->dz_hole, e->dz_hole, 1e-6, 0);
    note_(cmp, F_CROSS_SIGMA, r->cross_slope_sigma, e->cross_slope_sigma, 0.0, 0);
    note_(cmp, F_CONF, r->confidence, e->confidence, 1e-6, 0);
    note_(cmp, F_A_R, r->a_r, e->a_r, 0.0, 0);
    note_(cmp, F_GRAIN, r->grain[0], e->grain[0], 0.0, 0);
    note_(cmp, F_GRAIN, r->grain[1], e->grain[1], 0.0, 0);
    for (int i = 0; i < 5; i++) {
        note_(cmp, (i < 2) ? F_PATCH_AB : F_PATCH_CDE, r->patch[i], e->patch[i], (i < 2) ? 1e-7 : 1e-8, 0);
    }
    for (int i = 0; i < 2; i++) {
        note_(cmp, F_LEVEL, r->level_offsets[i], e->level_offsets[i], 1e-8, 0);
        note_(cmp, F_TILT, r->tilt_slopes[i], e->tilt_slopes[i], 1e-7, 0);
    }
    for (unsigned i = 0; i < e->n_stations && i < 4u; i++) {
        note_(cmp, F_STATION, r->stations[i], e->stations[i], 0.0, 0);
    }
    note_(cmp, F_RANGE, r->range_stereo, e->range_stereo, 0.0, 0);
    note_(cmp, F_RANGE, r->range_mono, e->range_mono, 0.0, 0);
    if (!straight) {
        note_(cmp, F_COST, r->fit_cost, e->fit_cost, 1e-6, 0);
    }
}

/** The outputs of the aim solve are defined (not the best iterate of a
 *  failed solve). */
static int aim_defined_(const gl_vec_expected_t *e)
{
    return e->aim_source != 2u;
}

/* ---- small statistics ------------------------------------------------------------- */

#define MAX_SAMPLES 8192
typedef struct {
    double v[MAX_SAMPLES];
    unsigned n;
} samples_t;

static void add_(samples_t *s, double v)
{
    if (s->n < MAX_SAMPLES) {
        s->v[s->n++] = v;
    }
}

static int cmp_double_(const void *a, const void *b)
{
    const double x = *(const double *)a, y = *(const double *)b;
    return (x > y) - (x < y);
}

/** Sorts; returns the maximum, *median and *p99 on the way. */
static double summarise_(samples_t *s, double *median, double *p99)
{
    if (s->n == 0u) {
        *median = 0.0;
        *p99 = 0.0;
        return 0.0;
    }
    qsort(s->v, s->n, sizeof(double), cmp_double_);
    *median = s->v[s->n / 2u];
    *p99 = s->v[(unsigned)((double)(s->n - 1u) * 0.99)];
    return s->v[s->n - 1u];
}

static void print_row_(const char *label, samples_t *s, double bound, const char *note)
{
    double med, p99;
    const double mx = summarise_(s, &med, &p99);
    printf("      %-44s %10.3e %10.3e %10.3e   %-9.3g %s\n", label, med, p99, mx, bound, note);
}

/* ====================================================================================== */

GL_TEST(test_api_and_sizes)
{
    char why[200];
    unsigned failed = gl_vec32_api_checks(why, (unsigned)sizeof(why));
    if (failed != 0u) {
        printf("    single: %u API checks failed, first: %s\n", failed, why);
    }
    GL_CHECK_EQ(failed, 0);
    failed = gl_vec64_api_checks(why, (unsigned)sizeof(why));
    if (failed != 0u) {
        printf("    double: %u API checks failed, first: %s\n", failed, why);
    }
    GL_CHECK_EQ(failed, 0);
    GL_CHECK_EQ(gl_vec32_real_bits(), 32);
    GL_CHECK_EQ(gl_vec64_real_bits(), 64);
    GL_CHECK(gl_vec32_version() != 0u && gl_vec32_version() == gl_vec64_version());
    GL_CHECK_EQ(gl_solver_version(), GL_SOLVER_VERSION);
    printf("    gl_solver_version 0x%08lx; reference vectors sha256 %.16s...\n",
           (unsigned long)gl_solver_version(), gl_vec_source_sha256);
    printf("    host sizeof, single / double: gl_solver_work_t %u / %u, gl_measurements_t %u / %u, "
           "gl_estimate_t %u / %u, gl_patch_fit_t %u / %u\n",
           gl_vec32_sizeof(0), gl_vec64_sizeof(0), gl_vec32_sizeof(1), gl_vec64_sizeof(1),
           gl_vec32_sizeof(2), gl_vec64_sizeof(2), gl_vec32_sizeof(3), gl_vec64_sizeof(3));
    /* the constants the vectors were generated with are the port's */
    GL_CHECK_NEAR(gl_vec_const_hole_r, (double)GL_SOLVER_HOLE_RADIUS_M, 1e-9);
    GL_CHECK_NEAR(gl_vec_const_dt, 0.02, 0.0);
    GL_CHECK_NEAR(gl_vec_const_t_max, 30.0, 0.0);
    GL_CHECK_EQ(gl_vec_const_step_budget_factor, 4);
    GL_CHECK_EQ(gl_vec_const_max_rolls, GL_SOLVER_DEFAULT_MAX_ROLLS);
    GL_CHECK_EQ(gl_vec_n_est_original, 240);
    GL_CHECK_EQ(gl_vec_n_sol_original, 120);
}

/* ---- double build: every vector within the tolerance of REFERENCE_VECTORS.md -------- */

GL_TEST(test_double_reproduces_every_estimator_vector)
{
    for (unsigned group = 0; group < 2u; group++) {
        double diff[F_COUNT] = { 0.0 };
        double worst = 0.0;
        int worst_field = -1;
        unsigned worst_id = 0u, n = 0u, n_fail = 0u, n_best = 0u, n_best_same = 0u, n_survey = 0u;
        for (unsigned i = 0; i < gl_vec_n_est; i++) {
            const gl_vec_est_case_t *c = &gl_vec_est[i];
            gl_vec_est_result_t r;
            est_cmp_t cmp;
            int ok;
            if (c->group != group) {
                continue;
            }
            n++;
            gl_vec64_estimate(c, GL_VEC_TOL_CASE, 0, &r);
            compare_estimate_(c, &r, aim_defined_(&c->exp), &cmp);
            ok = (r.status == ST_OK) && cmp.flags_equal && cmp.worst <= 1.0;
            if (!ok) {
                n_fail++;
                if (n_fail <= 10u) {
                    printf("    FAIL group %u case %u (%s): status %d, flags %s, worst %.3g x allowed (%s)\n",
                           group, c->id, c->mode, r.status, cmp.flags_equal ? "equal" : "DIFFER", cmp.worst,
                           (cmp.worst_field >= 0) ? FIELD_NAME[cmp.worst_field] : "-");
                }
            }
            GL_CHECK(ok);
            for (int f = 0; f < F_COUNT; f++) {
                if (cmp.diff[f] > diff[f]) {
                    diff[f] = cmp.diff[f];
                }
            }
            if (cmp.worst > worst) {
                worst = cmp.worst;
                worst_field = cmp.worst_field;
                worst_id = c->id;
            }
            if (!aim_defined_(&c->exp)) {
                /* best iterate of a failed solve: informative only */
                n_best++;
                if (excess(r.phi, c->exp.phi, 1e-6, 1, NULL) <= 1.0 && excess(r.v0, c->exp.v0, 0.0, 0, NULL) <= 1.0) {
                    n_best_same++;
                }
            }
            if (c->n_drops > 1u) {
                /* the result does not depend on where the drop at the ball sits in the array */
                gl_vec_est_result_t r2;
                gl_vec64_estimate(c, GL_VEC_TOL_CASE, 1, &r2);
                n_survey++;
                GL_CHECK(r2.status == r.status && r2.phi == r.phi && r2.v0 == r.v0 &&
                         r2.patch[0] == r.patch[0] && r2.patch[3] == r.patch[3] &&
                         r2.confidence == r.confidence && r2.n_stations == r.n_stations);
            }
        }
        printf("    double, %s: %u cases, %u outside the tolerance; worst difference %.3g x allowed "
               "(%s of case %u)\n",
               (group == 0u) ? "estimator_cases" : "fallback_estimator_cases", n, n_fail, worst,
               (worst_field >= 0) ? FIELD_NAME[worst_field] : "-", worst_id);
        printf("      largest |C - reference|:");
        for (int f = 0; f < F_COUNT; f++) {
            printf("%s %s %.1e", (f % 4 == 0) ? "\n       " : ";", FIELD_NAME[f], diff[f]);
        }
        printf("\n      %u Survey cases repeated with the ball's drop last in the array: identical\n", n_survey);
        if (n_best > 0u) {
            printf("      best iterate of the %u failed solves (not required): %u also within the tolerance\n",
                   n_best, n_best_same);
        }
        GL_CHECK_EQ(n_fail, 0);
        GL_CHECK(n > 0u);
    }
}

GL_TEST(test_double_reproduces_every_solver_vector)
{
    for (unsigned group = 0; group < 2u; group++) {
        unsigned n = 0u, n_fail = 0u, n_values = 0u, n_rolls_same = 0u, n_rolls_known = 0u, n_best = 0u,
                 n_best_same = 0u;
        double worst = 0.0;
        unsigned worst_id = 0u;
        for (unsigned i = 0; i < gl_vec_n_sol; i++) {
            const gl_vec_sol_case_t *c = &gl_vec_sol[i];
            gl_vec_sol_result_t r;
            int ok;
            double ex = 0.0, e1;
            if (c->group != group) {
                continue;
            }
            n++;
            gl_vec64_solve(c, GL_VEC_TOL_CASE, &r);
            ok = (r.status == ST_OK) && (r.solve_status == c->status);
            if (c->compare_values && ok) {
                n_values++;
                e1 = excess(r.phi, c->phi, 1e-6, 1, NULL);
                ex = (e1 > ex) ? e1 : ex;
                e1 = excess(r.v0, c->v0, 0.0, 0, NULL);
                ex = (e1 > ex) ? e1 : ex;
                e1 = excess(r.v0 * r.v0 / (2.0 * c->a_r), c->plays_like, 0.0, 0, NULL);
                ex = (e1 > ex) ? e1 : ex;
                e1 = excess(c->distance * tan(r.phi), c->aim_offset, 1e-6, 0, NULL);
                ex = (e1 > ex) ? e1 : ex;
                ok = ok && ex <= 1.0;
                if (ex > worst) {
                    worst = ex;
                    worst_id = c->id;
                }
            } else if (ok && c->status != 5u) {
                n_best++;
                if (excess(r.phi, c->phi, 1e-6, 1, NULL) <= 1.0 && excess(r.v0, c->v0, 0.0, 0, NULL) <= 1.0) {
                    n_best_same++;
                }
            }
            if (c->n_rolls >= 0) {
                n_rolls_known++;
                n_rolls_same += (r.n_rolls == (uint32_t)c->n_rolls) ? 1u : 0u;
            }
            if (!ok) {
                n_fail++;
                printf("    FAIL group %u case %u (%s): status %d / %u, reference %u, %.3g x allowed\n", group, c->id,
                       c->tag, r.status, r.solve_status, c->status, ex);
            }
            GL_CHECK(ok);
        }
        printf("    double, %s: %u cases, status equal in all but %u; values of the %u solved cases: worst "
               "difference %.3g x allowed (case %u)\n",
               (group == 0u) ? "solver_cases" : "fallback_solver_cases", n, n_fail, n_values, worst, worst_id);
        if (n_rolls_known > 0u) {
            printf("      same number of trial rolls as the reference: %u of %u; best iterate of the %u failed "
                   "solves (not required): %u within the tolerance\n",
                   n_rolls_same, n_rolls_known, n_best, n_best_same);
        }
        GL_CHECK_EQ(n_fail, 0);
    }
}

GL_TEST(test_double_reproduces_every_roll_vector)
{
    unsigned n_fail = 0u;
    double worst = 0.0;
    unsigned by_status[5] = { 0u, 0u, 0u, 0u, 0u }, holed = 0u;
    for (unsigned i = 0; i < gl_vec_n_roll; i++) {
        const gl_vec_roll_case_t *c = &gl_vec_roll[i];
        gl_vec_roll_result_t r;
        double d = 0.0, e1;
        int ok;
        gl_vec64_roll(c, &r);
        ok = (r.status == ST_OK) && r.roll_status == c->status && r.captured == c->captured &&
             r.crossed == c->crossed && r.side == c->side && r.n_steps == c->n_steps;
        e1 = fabs(r.t_end - c->t_end);
        d = (e1 > d) ? e1 : d;
        e1 = hypot(r.stop_xy[0] - c->stop_xy[0], r.stop_xy[1] - c->stop_xy[1]);
        d = (e1 > d) ? e1 : d;
        e1 = fabs(r.delta - c->delta);
        d = (e1 > d) ? e1 : d;
        e1 = fabs(r.speed_at_delta - c->speed_at_delta);
        d = (e1 > d) ? e1 : d;
        e1 = fabs(r.lateral_miss - c->lateral_miss);
        d = (e1 > d) ? e1 : d;
        e1 = fabs(r.shortfall - c->shortfall);
        d = (e1 > d) ? e1 : d;
        e1 = fabs(r.path_length - c->path_length);
        d = (e1 > d) ? e1 : d;
        if (c->crossed) {
            e1 = fabs(r.lateral_at_line - c->lateral_at_line);
            d = (e1 > d) ? e1 : d;
            e1 = fabs(r.speed_at_line - c->speed_at_line);
            d = (e1 > d) ? e1 : d;
        } else {
            ok = ok && isnan(r.lateral_at_line) && isnan(r.speed_at_line);
        }
        ok = ok && d <= 1e-9;
        worst = (d > worst) ? d : worst;
        if (!ok) {
            n_fail++;
            printf("    FAIL roll %u (%s): status %d / %u (ref %u), holed %u (%u), steps %lu (%lu), diff %.3g\n",
                   c->id, c->tag, r.status, r.roll_status, c->status, r.captured, c->captured,
                   (unsigned long)r.n_steps, (unsigned long)c->n_steps, d);
        }
        GL_CHECK(ok);
        if (c->status < 5u) {
            by_status[c->status]++;
        }
        holed += c->captured;
    }
    printf("    double, roll_cases: %u rolls (stopped %u, time limit %u, out of bounds %u, stopped on capture %u; "
           "%u holed), %u differ; status, capture, side and step count exact, largest difference %.1e\n",
           gl_vec_n_roll, by_status[0], by_status[1], by_status[2], by_status[3], holed, n_fail, worst);
    GL_CHECK_EQ(n_fail, 0);
    /* the group reaches every way a roll can end */
    GL_CHECK(by_status[0] > 0u && by_status[1] > 0u && by_status[2] > 0u && by_status[3] > 0u);
    GL_CHECK(holed > 0u && holed < gl_vec_n_roll);
}

/* ---- the single-precision roll kernel against the double one ------------------------- */

static uint32_t lcg_ = 12345u;
static double lcg_uniform_(void)
{
    lcg_ = lcg_ * 1664525u + 1013904223u;
    return (double)(lcg_ >> 8) / 16777216.0;
}

/* worst differences found by test_single_precision_roll_kernel (used to print the margins) */
static double kernel_lateral_max_ = 0.0, kernel_v2_max_ = 0.0;

GL_TEST(test_single_precision_roll_kernel)
{
    /* The SAME launch rolled in both precisions, around the solution of
     * every solved vector: how far apart do the two kernels cross the hole
     * line?  This is the noise floor below which no tolerance of the
     * single-precision solver can go; the default tolerances are set a
     * factor above it (gl_solver.h) and that factor is asserted here. */
    static samples_t lat, v2;
    unsigned n_launch = 0u;
    double med, p99;
    lat.n = 0u;
    v2.n = 0u;
    for (unsigned pass = 0; pass < 2u; pass++) {
        const unsigned n_case = (pass == 0u) ? gl_vec_n_est : gl_vec_n_sol;
        for (unsigned i = 0; i < n_case; i++) {
            double coeffs[5], grain[2], dist, a_r, phi, v0;
            if (pass == 0u) {
                const gl_vec_est_case_t *c = &gl_vec_est[i];
                if (c->exp.aim_source != 0u || c->exp.solve_status != 0u) {
                    continue;
                }
                memcpy(coeffs, c->exp.patch, sizeof(coeffs));
                memcpy(grain, c->exp.grain, sizeof(grain));
                dist = c->exp.distance;
                a_r = c->exp.a_r;
                phi = c->exp.phi;
                v0 = c->exp.v0;
            } else {
                const gl_vec_sol_case_t *c = &gl_vec_sol[i];
                if (c->status != 0u) {
                    continue;
                }
                memcpy(coeffs, c->coeffs, sizeof(coeffs));
                memcpy(grain, c->grain, sizeof(grain));
                dist = c->distance;
                a_r = c->a_r;
                phi = c->phi;
                v0 = c->v0;
            }
            for (int k = 0; k < 20; k++) {
                /* both kernels are given the launch as a single-precision number */
                const float phi_f = (float)(phi + 0.02 * (lcg_uniform_() - 0.5));
                const float v0_f = (float)(v0 * (1.0 + 0.06 * lcg_uniform_()));
                float cf[5], gf[2];
                double c64[5], g64[2], l32, s32, l64, s64;
                for (int j = 0; j < 5; j++) {
                    cf[j] = (float)coeffs[j];
                    c64[j] = (double)cf[j];
                }
                gf[0] = (float)grain[0];
                gf[1] = (float)grain[1];
                g64[0] = (double)gf[0];
                g64[1] = (double)gf[1];
                if (gl_vec32_roll_patch(c64, (double)(float)dist, (double)(float)a_r, g64, (double)phi_f,
                                        (double)v0_f, &l32, &s32) &&
                    gl_vec64_roll_patch(c64, (double)(float)dist, (double)(float)a_r, g64, (double)phi_f,
                                        (double)v0_f, &l64, &s64)) {
                    add_(&lat, fabs(l32 - l64));
                    add_(&v2, fabs(s32 * s32 - s64 * s64));
                    n_launch++;
                }
            }
        }
    }
    kernel_lateral_max_ = summarise_(&lat, &med, &p99);
    printf("    %u launches rolled in single and in double precision:\n", n_launch);
    printf("      lateral position at the hole line, |single - double|: median %.2e m, 99 %% %.2e m, max %.2e m\n",
           med, p99, kernel_lateral_max_);
    kernel_v2_max_ = summarise_(&v2, &med, &p99);
    printf("      squared arrival speed, |single - double|:              median %.2e, 99 %% %.2e, max %.2e m^2/s^2\n",
           med, p99, kernel_v2_max_);
    {
        const double tol_miss = (double)GL_SOLVER_SINGLE_TOL_MISS_M;
        const double tol_g_min = 2.0 * (1.83 * 1.83 / (2.0 * 16.0 * 0.3048)) * (double)GL_SOLVER_SINGLE_TOL_PACE_M;
        printf("      single-precision tolerances: tol_miss %.0e m = %.1f x that maximum; pace tolerance as energy at "
               "Stimp 16, %.2e m^2/s^2 = %.1f x that maximum\n",
               tol_miss, tol_miss / kernel_lateral_max_, tol_g_min, tol_g_min / kernel_v2_max_);
        GL_CHECK(n_launch > 5000u);
        /* the margins the choice of the tolerances rests on */
        GL_CHECK(kernel_lateral_max_ * 5.0 <= tol_miss);
        GL_CHECK(kernel_v2_max_ * 3.0 <= tol_g_min);
    }
}

/* ---- single build: measured deviation from the reference ----------------------------- */

typedef struct {
    samples_t aim_mrad, v0_pct, aim_point_mm, lateral_mm, rollout_mm, dist_mm, cups, conf, slope, plays_mm, dz_mm;
} deviation_t;

static deviation_t dev_; /* too large for the stack */

static void deviation_add_(deviation_t *d, const gl_vec_est_case_t *c, const gl_vec_est_result_t *r)
{
    const gl_vec_expected_t *e = &c->exp;
    double lat, speed;
    add_(&d->aim_mrad, 1e3 * angle_diff(r->aim_azimuth_device, e->aim_azimuth_device));
    add_(&d->v0_pct, 100.0 * fabs(r->v0 / e->v0 - 1.0));
    add_(&d->aim_point_mm, 1e3 * fabs(r->break_m - e->break_m));
    add_(&d->dist_mm, 1e3 * fabs(r->distance - e->distance));
    add_(&d->cups, fabs(r->break_cups - e->break_cups));
    add_(&d->conf, fabs(r->confidence - e->confidence));
    add_(&d->slope, fabs(r->slope_pct - e->slope_pct));
    add_(&d->plays_mm, 1e3 * fabs(r->plays_like - e->plays_like));
    add_(&d->dz_mm, 1e3 * fabs(r->dz_hole - e->dz_hole));
    /* where does the single-precision putt go on the REFERENCE's patch?  Rolled
     * with the double-precision kernel: lateral position at the hole, and
     * how far past the hole it would roll on a flat green against the target */
    if (e->aim_source == 0u &&
        gl_vec64_roll_patch(e->patch, e->distance, e->a_r, e->grain, r->phi, r->v0, &lat, &speed)) {
        add_(&d->lateral_mm, 1e3 * fabs(lat));
        add_(&d->rollout_mm, 1e3 * fabs(speed * speed / (2.0 * e->a_r) - c->past));
    }
}

GL_TEST(test_single_precision_estimator_deviation)
{
    /* ---- the 240 simulated reads -------------------------------------------------- */
    unsigned n = 0u, n_status = 0u, n_flags = 0u;
    uint32_t max_rolls = 0u, max_steps = 0u, max_iter = 0u;
    double sum_rolls = 0.0, sum_steps = 0.0;
    double med, p99;
    memset(&dev_, 0, sizeof(dev_));
    for (unsigned i = 0; i < gl_vec_n_est_original; i++) {
        const gl_vec_est_case_t *c = &gl_vec_est[i];
        gl_vec_est_result_t r;
        gl_vec32_estimate(c, GL_VEC_TOL_DEFAULT, 0, &r);
        n++;
        if (r.status != ST_OK) {
            n_status++;
            continue;
        }
        if (!flags_equal_(&r, &c->exp)) {
            n_flags++;
            printf("    case %u (%s): flags or codes differ (aim_source %u / %u, solve_status %u / %u, converged %u / %u)\n",
                   c->id, c->mode, r.aim_source, c->exp.aim_source, r.solve_status, c->exp.solve_status,
                   r.fit_converged, c->exp.fit_converged);
            continue;
        }
        deviation_add_(&dev_, c, &r);
        sum_rolls += (double)r.n_rolls;
        sum_steps += (double)r.n_steps;
        max_rolls = (r.n_rolls > max_rolls) ? r.n_rolls : max_rolls;
        max_steps = (r.n_steps > max_steps) ? r.n_steps : max_steps;
        max_iter = (r.n_iter > max_iter) ? r.n_iter : max_iter;
    }
    printf("    single precision, firmware default tolerances (tol_miss %.0e m, tol_pace %.0e m, lm_tol %.0e), against\n"
           "    the reference at 1e-9 m / 1e-10: %u simulated reads, %u not GL_OK, %u with a flag or code that differs\n",
           (double)GL_SOLVER_SINGLE_TOL_MISS_M, (double)GL_SOLVER_SINGLE_TOL_PACE_M, (double)GL_SOLVER_SINGLE_LM_TOL,
           n, n_status, n_flags);
    GL_CHECK_EQ(n_status, 0);
    GL_CHECK_EQ(n_flags, 0);
    printf("      |single - reference|                           median        99 %%        max   bound     \n");
    {
        /* measured maxima (this file's own output) and the bound asserted, about 1.5 x */
        double m_aim, m_v0, m_pt, m_lat, m_roll, m_dist, m_cups, m_conf, m_slope, m_plays, m_dz;
        char note[96];
        m_aim = summarise_(&dev_.aim_mrad, &med, &p99);
        snprintf(note, sizeof(note), "(max = 1/%.0f of a %.2f mrad display step)", DISPLAY_STEP_MRAD / m_aim,
                 DISPLAY_STEP_MRAD);
        print_row_("aim direction [mrad]", &dev_.aim_mrad, 0.20, note);
        m_v0 = summarise_(&dev_.v0_pct, &med, &p99);
        print_row_("launch speed [%]", &dev_.v0_pct, 0.045, "");
        m_pt = summarise_(&dev_.aim_point_mm, &med, &p99);
        print_row_("aim point at the hole, D tan(phi) [mm]", &dev_.aim_point_mm, 0.70, "");
        m_lat = summarise_(&dev_.lateral_mm, &med, &p99);
        print_row_("ball at the hole, rolled in double [mm]", &dev_.lateral_mm, 0.30, "(hole radius 54 mm)");
        m_roll = summarise_(&dev_.rollout_mm, &med, &p99);
        print_row_("roll-out past the hole [mm]", &dev_.rollout_mm, 1.5, "(target 300 mm)");
        m_dist = summarise_(&dev_.dist_mm, &med, &p99);
        print_row_("displayed distance [mm]", &dev_.dist_mm, 0.003, "(shown to 0.1 m)");
        m_cups = summarise_(&dev_.cups, &med, &p99);
        print_row_("break [cup widths]", &dev_.cups, 0.0065, "(shown to 0.1 cup)");
        m_conf = summarise_(&dev_.conf, &med, &p99);
        print_row_("confidence [0..1]", &dev_.conf, 5e-7, "");
        m_slope = summarise_(&dev_.slope, &med, &p99);
        print_row_("slope at the ball [%]", &dev_.slope, 2e-6, "");
        m_plays = summarise_(&dev_.plays_mm, &med, &p99);
        print_row_("plays-like distance [mm]", &dev_.plays_mm, 1.5, "");
        m_dz = summarise_(&dev_.dz_mm, &med, &p99);
        print_row_("height of the hole [mm]", &dev_.dz_mm, 3e-4, "");
        printf("      yardstick: one step of the reference's display model is %.2f mrad (0.94 degree; the firmware's\n"
               "      line is finer, 0.05 degree rms): the largest single-precision error of the aim direction is\n"
               "      %.3f mrad = %.4f of one step (median %.4f of one step)\n",
               DISPLAY_STEP_MRAD, m_aim, m_aim / DISPLAY_STEP_MRAD, dev_.aim_mrad.v[dev_.aim_mrad.n / 2u] / DISPLAY_STEP_MRAD);
        printf("      work: %.1f trial rolls and %.0f RK4 steps per read on average, at most %lu rolls / %lu steps; "
               "at most %lu fit iterations\n",
               sum_rolls / (double)n, sum_steps / (double)n, (unsigned long)max_rolls, (unsigned long)max_steps,
               (unsigned long)max_iter);
        GL_CHECK(dev_.aim_mrad.n == gl_vec_n_est_original);
        GL_CHECK(m_aim <= 0.20);
        GL_CHECK(m_aim <= DISPLAY_STEP_MRAD / 50.0);
        GL_CHECK(m_v0 <= 0.045);
        GL_CHECK(m_pt <= 0.70);
        GL_CHECK(m_lat <= 0.30);
        GL_CHECK(m_roll <= 1.5);
        GL_CHECK(m_dist <= 0.003);
        GL_CHECK(m_cups <= 0.0065);
        GL_CHECK(m_conf <= 5e-7);
        GL_CHECK(m_slope <= 2e-6);
        GL_CHECK(m_plays <= 1.5);
        GL_CHECK(m_dz <= 3e-4);
    }
}

/** Does the double build, run with the single build's tolerances, end the
 *  same way as the single build?  Then a difference from the reference
 *  comes from the tolerance, not from the arithmetic. */
static int same_outcome_at_single_tolerance_(const gl_vec_est_case_t *c, const gl_vec_est_result_t *r32)
{
    gl_vec_est_result_t r64;
    gl_vec64_estimate(c, GL_VEC_TOL_SINGLE, 0, &r64);
    return r64.status == r32->status && r64.aim_source == r32->aim_source &&
           r64.solve_status == r32->solve_status && r64.fit_converged == r32->fit_converged &&
           r64.base_hidden == r32->base_hidden && r64.flag_missing == r32->flag_missing &&
           r64.range_missing == r32->range_missing && r64.poor_horizon == r32->poor_horizon &&
           r64.used_horizon == r32->used_horizon && r64.fit_starts == r32->fit_starts;
}

GL_TEST(test_single_precision_fallback_cases)
{
    /* The 82 fallback cases: flags and codes against the reference; values
     * where the aim is defined.  These patches are steep or pathological by
     * construction, so their numbers are reported apart from the reads. */
    unsigned n = 0u, n_status = 0u, n_equal = 0u, n_tolerance = 0u, n_unexplained = 0u, n_values = 0u;
    unsigned src32[4] = { 0u, 0u, 0u, 0u }, st32[6] = { 0u, 0u, 0u, 0u, 0u, 0u }, nonconv32 = 0u;
    uint32_t max_rolls = 0u, max_steps = 0u;
    unsigned id_rolls = 0u;
    double med, p99, m_aim, m_v0, m_pt, m_conf;
    static samples_t aim, v0, pt, conf;
    aim.n = 0u;
    v0.n = 0u;
    pt.n = 0u;
    conf.n = 0u;
    for (unsigned i = gl_vec_n_est_original; i < gl_vec_n_est_near_first; i++) {
        const gl_vec_est_case_t *c = &gl_vec_est[i];
        gl_vec_est_result_t r;
        gl_vec32_estimate(c, GL_VEC_TOL_DEFAULT, 0, &r);
        n++;
        if (r.status != ST_OK) {
            n_status++;
            printf("    fallback case %u: status %d\n", c->id, r.status);
            continue;
        }
        src32[r.aim_source & 3u]++;
        st32[(r.solve_status < 6u) ? r.solve_status : 5u]++;
        nonconv32 += r.fit_converged ? 0u : 1u;
        if (r.n_steps > max_steps) {
            max_steps = r.n_steps;
            max_rolls = r.n_rolls;
            id_rolls = c->id;
        }
        if (flags_equal_(&r, &c->exp)) {
            n_equal++;
            if (c->exp.aim_source <= 1u) {
                n_values++;
                add_(&aim, 1e3 * angle_diff(r.aim_azimuth_device, c->exp.aim_azimuth_device));
                add_(&v0, 100.0 * fabs(r.v0 / c->exp.v0 - 1.0));
                add_(&pt, 1e3 * fabs(r.break_m - c->exp.break_m));
            }
            add_(&conf, fabs(r.confidence - c->exp.confidence));
        } else if (same_outcome_at_single_tolerance_(c, &r)) {
            n_tolerance++;
            printf("    NOT MET, fallback case %u: single precision ends with aim_source %u, solve_status %s; the\n"
                   "      reference (1e-9 m) with aim_source %u, %s.  The DOUBLE build with the single-precision\n"
                   "      tolerances ends like the single build: a tolerance effect, not an arithmetic one.\n"
                   "      [%s]\n",
                   c->id, r.aim_source, STATUS_NAME[(r.solve_status < 6u) ? r.solve_status : 5u], c->exp.aim_source,
                   STATUS_NAME[c->exp.solve_status], c->tag);
        } else {
            n_unexplained++;
            printf("    FAIL fallback case %u (%s): aim_source %u / %u, solve_status %u / %u, converged %u / %u, "
                   "stations %u / %u\n",
                   c->id, c->tag, r.aim_source, c->exp.aim_source, r.solve_status, c->exp.solve_status,
                   r.fit_converged, c->exp.fit_converged, r.n_stations, c->exp.n_stations);
        }
    }
    printf("    single precision, %u fallback cases: %u not GL_OK; flags and codes equal to the reference's in %u,\n"
           "    different because of the tolerance in %u (NOT MET, listed above), different otherwise in %u\n",
           n, n_status, n_equal, n_tolerance, n_unexplained);
    printf("      single-precision outcomes: aim_source 0/1/2/3 = %u/%u/%u/%u; solve_status", src32[0], src32[1],
           src32[2], src32[3]);
    for (int s = 0; s < 6; s++) {
        printf(" %s %u%s", STATUS_NAME[s], st32[s], (s < 5) ? "," : "");
    }
    printf("; fits not converged %u\n", nonconv32);
    m_aim = summarise_(&aim, &med, &p99);
    printf("      values of the %u cases with a defined aim: |single - reference|   median   99 %%   max\n", n_values);
    printf("        aim direction [mrad]              %10.3e %10.3e %10.3e  (max = %.3f display steps)\n", med, p99,
           m_aim, m_aim / DISPLAY_STEP_MRAD);
    m_v0 = summarise_(&v0, &med, &p99);
    printf("        launch speed [%%]                  %10.3e %10.3e %10.3e\n", med, p99, m_v0);
    m_pt = summarise_(&pt, &med, &p99);
    printf("        aim point at the hole [mm]        %10.3e %10.3e %10.3e\n", med, p99, m_pt);
    m_conf = summarise_(&conf, &med, &p99);
    printf("        confidence                        %10.3e %10.3e %10.3e\n", med, p99, m_conf);
    printf("      most work: case %u, %lu trial rolls, %lu RK4 steps\n", id_rolls, (unsigned long)max_rolls,
           (unsigned long)max_steps);
    GL_CHECK_EQ(n_status, 0);
    GL_CHECK_EQ(n_unexplained, 0);
    /* PINNED: two knife-edge cases end differently at the firmware's tolerances */
    GL_CHECK_EQ(n_tolerance, 2);
    GL_CHECK_EQ(n_equal + n_tolerance, n);
    /* every aim source and every solve status is reached in single precision too */
    for (int s = 0; s < 4; s++) {
        GL_CHECK(src32[s] > 0u);
    }
    for (int s = 0; s < 6; s++) {
        GL_CHECK(st32[s] > 0u);
    }
    GL_CHECK(nonconv32 >= 6u);
    /* measured maxima: aim 0.099 mrad, speed 0.012 %, aim point 0.48 mm,
     * confidence 5.2e-8; bounds about 1.5 x */
    GL_CHECK(m_aim <= 0.15);
    GL_CHECK(m_v0 <= 0.018);
    GL_CHECK(m_pt <= 0.75);
    GL_CHECK(m_conf <= 1e-7);
}

GL_TEST(test_single_precision_solver_deviation)
{
    for (unsigned group = 0; group < 2u; group++) {
        unsigned n = 0u, n_same = 0u, n_tolerance = 0u, n_unexplained = 0u, n_err = 0u, n_ok = 0u;
        uint32_t max_rolls = 0u;
        double sum_rolls = 0.0, sum_ref_rolls = 0.0;
        double med, p99, m_aim, m_v0, m_pt, m_lat, worst_aim = -1.0;
        const gl_vec_sol_case_t *worst_case = NULL;
        static samples_t aim, v0, pt, lat;
        aim.n = 0u;
        v0.n = 0u;
        pt.n = 0u;
        lat.n = 0u;
        for (unsigned i = 0; i < gl_vec_n_sol; i++) {
            const gl_vec_sol_case_t *c = &gl_vec_sol[i];
            gl_vec_sol_result_t r, r64;
            double l, s;
            if (c->group != group) {
                continue;
            }
            n++;
            gl_vec32_solve(c, GL_VEC_TOL_DEFAULT, &r);
            if (r.status != ST_OK) {
                n_err++;
                continue;
            }
            if (r.solve_status == c->status) {
                n_same++;
                if (c->status == 0u) {
                    n_ok++;
                    add_(&aim, 1e3 * fabs(r.phi - c->phi));
                    if (1e3 * fabs(r.phi - c->phi) > worst_aim) {
                        worst_aim = 1e3 * fabs(r.phi - c->phi);
                        worst_case = c;
                    }
                    add_(&v0, 100.0 * fabs(r.v0 / c->v0 - 1.0));
                    add_(&pt, 1e3 * c->distance * fabs(tan(r.phi) - tan(c->phi)));
                    if (gl_vec64_roll_patch(c->coeffs, c->distance, c->a_r, c->grain, r.phi, r.v0, &l, &s)) {
                        add_(&lat, 1e3 * fabs(l));
                    }
                    sum_rolls += (double)r.n_rolls;
                    max_rolls = (r.n_rolls > max_rolls) ? r.n_rolls : max_rolls;
                    if (c->n_rolls > 0) {
                        sum_ref_rolls += (double)c->n_rolls;
                    }
                }
                continue;
            }
            gl_vec64_solve(c, GL_VEC_TOL_SINGLE, &r64);
            if (r64.status == ST_OK && r64.solve_status == r.solve_status) {
                n_tolerance++;
                printf("    NOT MET, %s case %u: single precision ends %s, the reference (1e-9 m) %s; the DOUBLE\n"
                       "      build with the single-precision tolerances also ends %s: a tolerance effect.  [%s]\n",
                       (group == 0u) ? "solver" : "fallback solver", c->id, STATUS_NAME[r.solve_status],
                       STATUS_NAME[c->status], STATUS_NAME[r64.solve_status], c->tag);
            } else {
                n_unexplained++;
                printf("    FAIL solver case %u (%s): single %u, reference %u, double at single tolerances %u\n",
                       c->id, c->tag, r.solve_status, c->status, r64.solve_status);
            }
        }
        printf("    single precision, %s: %u cases, %u not GL_OK; status equal to the reference's in %u, different\n"
               "    because of the tolerance in %u, different otherwise in %u\n",
               (group == 0u) ? "solver_cases" : "fallback_solver_cases", n, n_err, n_same, n_tolerance,
               n_unexplained);
        m_aim = summarise_(&aim, &med, &p99);
        printf("      the %u solved cases, |single - reference|:        median       99 %%        max\n", n_ok);
        printf("        aim direction [mrad]                     %10.3e %10.3e %10.3e  (max = %.4f display steps)\n",
               med, p99, m_aim, m_aim / DISPLAY_STEP_MRAD);
        m_v0 = summarise_(&v0, &med, &p99);
        printf("        launch speed [%%]                         %10.3e %10.3e %10.3e\n", med, p99, m_v0);
        m_pt = summarise_(&pt, &med, &p99);
        printf("        aim point at the hole [mm]               %10.3e %10.3e %10.3e\n", med, p99, m_pt);
        m_lat = summarise_(&lat, &med, &p99);
        printf("        ball at the hole, rolled in double [mm]  %10.3e %10.3e %10.3e\n", med, p99, m_lat);
        if (worst_case != NULL) {
            printf("      largest aim difference: case %u, %.1f m, past %.2f m [%s]\n", worst_case->id,
                   worst_case->distance, worst_case->past, worst_case->tag);
        }
        printf("      trial rolls per solved case: %.1f on average, at most %lu", sum_rolls / (double)(n_ok ? n_ok : 1u),
               (unsigned long)max_rolls);
        if (sum_ref_rolls > 0.0) {
            printf(" (the reference at 1e-9 m: %.1f)", sum_ref_rolls / (double)(n_ok ? n_ok : 1u));
        }
        printf("\n");
        GL_CHECK_EQ(n_err, 0);
        GL_CHECK_EQ(n_unexplained, 0);
        if (group == 0u) {
            /* The 120 original cases: no status differs.  Measured maxima:
             * aim 1.04 mrad, speed 0.079 %, aim point 3.1 mm - all three on
             * case 16, the putt down a slope at 0.9 of critical, where a
             * whole family of (aim, speed) pairs holes the putt within the
             * tolerance: rolled in double precision the single-precision
             * solution still crosses within 0.19 mm of the hole centre.
             * The 99th percentile of the aim difference is 0.10 mrad. */
            GL_CHECK_EQ(n_tolerance, 0);
            GL_CHECK(m_aim <= 1.6);
            GL_CHECK(p99 >= 0.0);
            GL_CHECK(m_v0 <= 0.12);
            GL_CHECK(m_pt <= 4.7);
            GL_CHECK(m_lat <= 0.30);
        } else {
            /* PINNED: the four cases whose tag says that the outcome depends
             * on the tolerance.  Measured maxima: aim 1.3 mrad (the 2 um
             * putt, where an angle means nothing), speed 0.010 %, aim point
             * 0.10 mm, 0.13 mm at the hole. */
            GL_CHECK_EQ(n_tolerance, 4);
            GL_CHECK(m_aim <= 2.0);
            GL_CHECK(m_v0 <= 0.016);
            GL_CHECK(m_pt <= 0.15);
            GL_CHECK(m_lat <= 0.20);
        }
    }
}

/* ---- coverage: every aim source, every status ------------------------------------------ */

GL_TEST(test_vectors_reach_every_aim_source_and_status)
{
    unsigned ref_pair[4][6], c_pair[4][6];
    unsigned ref_nonconv = 0u, c_nonconv = 0u, sol_status[6] = { 0u, 0u, 0u, 0u, 0u, 0u };
    unsigned drops[5] = { 0u, 0u, 0u, 0u, 0u }, methods[4] = { 0u, 0u, 0u, 0u };
    unsigned flag_missing = 0u, range_missing = 0u, base_hidden = 0u, top_visible = 0u, top_hidden = 0u,
             dialled = 0u, precision = 0u, horizon = 0u, poor = 0u, mono = 0u;
    memset(ref_pair, 0, sizeof(ref_pair));
    memset(c_pair, 0, sizeof(c_pair));
    for (unsigned i = 0; i < gl_vec_n_est; i++) {
        const gl_vec_est_case_t *c = &gl_vec_est[i];
        const gl_vec_meas_t *m = &gl_vec_meas[c->first_meas];
        gl_vec_est_result_t r;
        gl_vec64_estimate(c, GL_VEC_TOL_CASE, 0, &r);
        ref_pair[c->exp.aim_source & 3u][(c->exp.solve_status < 6u) ? c->exp.solve_status : 5u]++;
        if (r.status == ST_OK && r.aim_source < 4u && r.solve_status < 6u) {
            c_pair[r.aim_source][r.solve_status]++;
        }
        ref_nonconv += c->exp.fit_converged ? 0u : 1u;
        c_nonconv += (r.status == ST_OK && !r.fit_converged) ? 1u : 0u;
        drops[(c->exp.n_stations < 5u) ? c->exp.n_stations : 0u]++;
        methods[c->method & 3u]++;
        flag_missing += c->exp.flag_missing;
        range_missing += c->exp.range_missing;
        base_hidden += c->exp.base_hidden;
        top_visible += (m->flag_found && m->flag_top_visible) ? 1u : 0u;
        top_hidden += (m->flag_found && !m->flag_top_visible) ? 1u : 0u;
        dialled += (!isnan(m->user_distance) && (c->exp.flag_missing || c->exp.range_missing)) ? 1u : 0u;
        precision += (m->tilt_reads >= 2u) ? 1u : 0u;
        horizon += c->exp.used_horizon;
        poor += c->exp.poor_horizon;
        mono += isnan(c->exp.range_mono) ? 0u : 1u;
    }
    printf("    estimator vectors by (aim_source, solve_status), reference = double build:\n");
    for (int s = 0; s < 4; s++) {
        for (int t = 0; t < 6; t++) {
            if (ref_pair[s][t] > 0u || c_pair[s][t] > 0u) {
                printf("      aim_source %d, %-14s %3u = %3u\n", s, STATUS_NAME[t], ref_pair[s][t], c_pair[s][t]);
            }
            GL_CHECK_EQ(c_pair[s][t], ref_pair[s][t]);
        }
    }
    /* everything the reference can produce is there:
     *   aim_source 0 with OK / PACE_LIMITED, 1 with OK / PACE_LIMITED,
     *   2 with UNREACHABLE / NO_BRACKET / NO_CONVERGENCE, 3 with OK
     *   (method STRAIGHT) / INVALID (zero distance) */
    GL_CHECK(ref_pair[0][0] > 0u && ref_pair[0][1] > 0u);
    GL_CHECK(ref_pair[1][0] > 0u && ref_pair[1][1] > 0u);
    GL_CHECK(ref_pair[2][2] > 0u && ref_pair[2][3] > 0u && ref_pair[2][4] > 0u);
    GL_CHECK(ref_pair[3][0] > 0u && ref_pair[3][5] > 0u);
    GL_CHECK(ref_nonconv >= 6u);
    GL_CHECK_EQ(c_nonconv, ref_nonconv);
    for (unsigned i = 0; i < gl_vec_n_sol; i++) {
        sol_status[(gl_vec_sol[i].status < 6u) ? gl_vec_sol[i].status : 5u]++;
    }
    printf("    solver vectors by status:");
    for (int t = 0; t < 6; t++) {
        printf(" %s %u%s", STATUS_NAME[t], sol_status[t], (t < 5) ? "," : "\n");
        GL_CHECK(sol_status[t] > 0u);
    }
    printf("    fits not converged %u; placements used 1/2/3/4: %u/%u/%u/%u; methods B1/B0/B2/STRAIGHT: "
           "%u/%u/%u/%u\n",
           ref_nonconv, drops[1], drops[2], drops[3], drops[4], methods[0], methods[1], methods[2], methods[3]);
    printf("    flag missing %u, flag not ranged %u, base hidden %u, stick top visible / not %u / %u, dialled "
           "distance used %u,\n    Precision Read %u, horizon used %u (poor %u), angular-height range %u\n",
           flag_missing, range_missing, base_hidden, top_visible, top_hidden, dialled, precision, horizon, poor,
           mono);
    GL_CHECK(drops[1] > 0u && drops[2] > 0u && drops[3] > 0u && drops[4] > 0u);
    GL_CHECK(methods[0] > 0u && methods[1] > 0u && methods[2] > 0u && methods[3] > 0u);
    GL_CHECK(flag_missing > 0u && range_missing > 0u && base_hidden > 0u && top_visible > 0u && top_hidden > 0u);
    GL_CHECK(dialled > 0u && precision > 0u && horizon > 0u && poor > 0u && mono > 0u);
}

/* ---- hostile inputs ------------------------------------------------------------------------ */

/* iterations of the hostile run: 7 calls each, in both precisions (the same
 * count under the sanitisers; about 12 s of the test's 14 s at -O2) */
#ifndef GL_SOLVER_HOSTILE_N
#define GL_SOLVER_HOSTILE_N 4000u
#endif

static void hostile_print_(const char *name, const gl_vec_hostile_t *h)
{
    printf("    %s: %u calls, %u GL_OK, %u GL_ERR_PARAM, %u GL_ERR_RANGE, %u violations\n", name, h->calls, h->ok,
           h->err_param, h->err_range, h->violations);
    printf("      estimates returned: aim_source 0/1/2/3 = %u/%u/%u/%u; solve_status", h->by_source[0], h->by_source[1],
           h->by_source[2], h->by_source[3]);
    for (int s = 0; s < 6; s++) {
        printf(" %s %u%s", STATUS_NAME[s], h->by_status[s], (s < 5) ? "," : "");
    }
    printf("; fit not converged %u\n      most trial rolls in one estimate %lu, most RK4 steps in one call %lu\n",
           h->not_converged, (unsigned long)h->max_rolls, (unsigned long)h->max_steps);
    if (h->violations != 0u) {
        printf("      first violation: %s\n", h->first_violation);
    }
}

GL_TEST(test_hostile_inputs_give_defined_results)
{
    /* Not-a-number, infinities, the largest and smallest numbers, zero
     * distance, absurd slopes, zero green speed, NULL pointers, options and
     * drop counts out of range, into every entry point.  Each call must
     * return GL_OK, GL_ERR_PARAM or GL_ERR_RANGE; with GL_OK every output
     * that gl_solver.h promises finite is finite, with an error the output
     * is the flagged record.  Under `make asan` this also shows that no
     * such input reads or writes out of bounds, converts an out-of-range
     * real to an integer, or overflows a signed integer. */
    static gl_vec_hostile_t h32, h64;
    gl_vec32_hostile(20261111u, GL_SOLVER_HOSTILE_N, &h32);
    gl_vec64_hostile(20261111u, GL_SOLVER_HOSTILE_N, &h64);
    hostile_print_("single", &h32);
    hostile_print_("double", &h64);
    GL_CHECK_EQ(h32.violations, 0);
    GL_CHECK_EQ(h64.violations, 0);
    GL_CHECK(h32.calls >= 6u * GL_SOLVER_HOSTILE_N && h64.calls == h32.calls);
    /* the run reaches every kind of return and every fallback */
    GL_CHECK(h32.ok > 0u && h32.err_param > 0u && h32.err_range > 0u);
    GL_CHECK(h64.ok > 0u && h64.err_param > 0u && h64.err_range > 0u);
    for (int s = 0; s < 4; s++) {
        GL_CHECK(h32.by_source[s] > 0u && h64.by_source[s] > 0u);
    }
    for (int s = 0; s < 6; s++) {
        GL_CHECK(h32.by_status[s] > 0u && h64.by_status[s] > 0u);
    }
}

/* ---- run time is bounded --------------------------------------------------------------------- */

GL_TEST(test_rolls_and_steps_are_bounded)
{
    /* One aim solve rolls at most max_rolls + 120 balls of at most 6004 RK4
     * steps; an estimate makes at most two aim solves. */
    uint32_t worst_rolls = 0u, worst_steps = 0u, worst_iter = 0u;
    for (unsigned i = 0; i < gl_vec_n_est; i++) {
        gl_vec_est_result_t r;
        gl_vec32_estimate(&gl_vec_est[i], GL_VEC_TOL_DEFAULT, 0, &r);
        GL_CHECK(r.n_rolls <= 2u * (GL_SOLVER_DEFAULT_MAX_ROLLS + 120u));
        GL_CHECK(r.n_steps <= r.n_rolls * 6004u);
        GL_CHECK(r.n_iter <= 60u || gl_vec_est[i].lm_max_iter_overridden);
        worst_rolls = (r.n_rolls > worst_rolls) ? r.n_rolls : worst_rolls;
        worst_steps = (r.n_steps > worst_steps) ? r.n_steps : worst_steps;
        worst_iter = (r.n_iter > worst_iter) ? r.n_iter : worst_iter;
    }
    for (unsigned i = 0; i < gl_vec_n_sol; i++) {
        gl_vec_sol_result_t r;
        gl_vec32_solve(&gl_vec_sol[i], GL_VEC_TOL_DEFAULT, &r);
        GL_CHECK(r.n_rolls <= (uint32_t)gl_vec_sol[i].max_rolls + 120u);
        GL_CHECK(r.n_steps <= r.n_rolls * 6004u);
    }
    printf("    single precision over all vectors: at most %lu trial rolls and %lu RK4 steps in one estimate "
           "(bounds: %u rolls, 6004 steps per roll), at most %lu fit iterations\n",
           (unsigned long)worst_rolls, (unsigned long)worst_steps, 2u * (GL_SOLVER_DEFAULT_MAX_ROLLS + 120u),
           (unsigned long)worst_iter);
}

/* ====================================================================================== */
/* phase-2 review                                                                         */
/* ====================================================================================== */

/* The reference's near_miss_keep (gl_solver_options_t.near_miss_m): the 18
 * appended cases.  The double build has already been compared with the
 * reference field by field (test_double_reproduces_every_estimator_vector);
 * here: what the rule does, measured by rolling the aims in double precision
 * on the fitted patch, and what the single build makes of the same reads. */
GL_TEST(test_near_miss_cases)
{
    unsigned n_kept = 0u, n_ctl = 0u, off_misses = 0u, off_short = 0u, single_holes = 0u, single_src0 = 0u;
    double worst_kept_mm = 0.0, worst_move_mrad = 0.0, worst_single_mm = 0.0;

    GL_CHECK_EQ(gl_vec_n_est - gl_vec_n_est_near_first, 18);
    printf("    id kept | reference with the rule: class, lateral of its aim at the hole | without the rule: class, "
           "lateral | aim moved | single build (firmware tolerances): class, lateral\n");
    for (unsigned i = gl_vec_n_est_near_first; i < gl_vec_n_est; i++) {
        const gl_vec_est_case_t *c = &gl_vec_est[i];
        gl_vec_est_case_t off = *c;
        gl_vec_est_result_t r, r_off, r32;
        double lat = NAN, sp = NAN, lat_off = NAN, lat32 = NAN;
        int crossed, crossed_off, crossed32;

        GL_CHECK_EQ(c->group, 2);
        GL_CHECK_NEAR(c->near_miss, 0.005, 0.0);
        gl_vec64_estimate(c, GL_VEC_TOL_CASE, 0, &r);
        off.near_miss = 0.0;
        gl_vec64_estimate(&off, GL_VEC_TOL_CASE, 0, &r_off);
        gl_vec32_estimate(c, GL_VEC_TOL_DEFAULT, 0, &r32);
        GL_CHECK_EQ(r.status, ST_OK);
        GL_CHECK_EQ(r_off.status, ST_OK);
        GL_CHECK_EQ(r32.status, ST_OK);
        /* the double build without the rule is the reference without the rule */
        GL_CHECK_EQ(r_off.aim_source, c->without_source);
        GL_CHECK_EQ(r_off.solve_status, c->without_status);
        GL_CHECK_NEAR(r_off.phi, c->without_phi, 1e-9 + 1e-9 * fabs(c->without_phi));
        GL_CHECK_NEAR(r_off.v0, c->without_v0, 1e-9 * c->without_v0);
        /* the rule never touches the fit */
        for (int k = 0; k < 5; k++) {
            GL_CHECK(r.patch[k] == r_off.patch[k]);
        }
        crossed = gl_vec64_roll_patch(r.patch, r.distance, r.a_r, r.grain, r.phi, r.v0, &lat, &sp);
        crossed_off = gl_vec64_roll_patch(r_off.patch, r_off.distance, r_off.a_r, r_off.grain, r_off.phi, r_off.v0,
                                          &lat_off, &sp);
        crossed32 = gl_vec64_roll_patch(r32.patch, r32.distance, r32.a_r, r32.grain, r32.phi, r32.v0, &lat32, &sp);
        if (c->kept) {
            n_kept++;
            /* kept: the patch iterate is the aim, flagged by the status of the solve */
            GL_CHECK_EQ(r.aim_source, 0);
            GL_CHECK(r.solve_status == 2u || r.solve_status == 3u || r.solve_status == 4u);
            GL_CHECK(r_off.aim_source == 1u || r_off.aim_source == 2u);
            GL_CHECK(fabs(c->patch_miss) <= 0.005);
            /* and it does what it says: within 5 mm of the hole centre on the fitted patch */
            GL_CHECK(crossed);
            GL_CHECK(fabs(lat) <= 0.005 + 1e-6);
            GL_CHECK_NEAR(lat, c->patch_miss, 1e-6);
            /* scored as a fallback, like the aim it replaces */
            GL_CHECK_NEAR(r.confidence, r_off.confidence, 1e-12);
            worst_kept_mm = (1e3 * fabs(lat) > worst_kept_mm) ? 1e3 * fabs(lat) : worst_kept_mm;
            if (1e3 * angle_diff(r.phi, r_off.phi) > worst_move_mrad) {
                worst_move_mrad = 1e3 * angle_diff(r.phi, r_off.phi);
            }
            if (!crossed_off) {
                off_short++;
            } else if (fabs(lat_off) > (double)GL_SOLVER_HOLE_RADIUS_M) {
                off_misses++;
            }
            /* single precision, firmware tolerances, the rule on: an aim on the patch */
            single_src0 += (r32.aim_source == 0u) ? 1u : 0u;
            if (crossed32 && fabs(lat32) <= 0.0055) {
                single_holes++;
            }
            if (r32.aim_source == 0u && crossed32 && 1e3 * fabs(lat32) > worst_single_mm) {
                worst_single_mm = 1e3 * fabs(lat32);
            }
        } else {
            n_ctl++;
            /* control: outside 5 mm, the estimate is the one without the rule */
            GL_CHECK(fabs(c->patch_miss) > 0.005);
            GL_CHECK_EQ(r.aim_source, r_off.aim_source);
            GL_CHECK_EQ(r.solve_status, r_off.solve_status);
            GL_CHECK(r.phi == r_off.phi && r.v0 == r_off.v0 && r.confidence == r_off.confidence);
        }
        printf("    %2u %-4s | (%u, %-14s) ", c->id, c->kept ? "yes" : "no", r.aim_source, STATUS_NAME[r.solve_status]);
        if (crossed) {
            printf("%+9.2f mm", 1e3 * lat);
        } else {
            printf("  short     ");
        }
        printf(" | (%u, %-14s) ", r_off.aim_source, STATUS_NAME[r_off.solve_status]);
        if (crossed_off) {
            printf("%+9.1f mm", 1e3 * lat_off);
        } else {
            printf("  short     ");
        }
        printf(" | %7.1f mrad | (%u, %-14s) ", 1e3 * angle_diff(r.phi, r_off.phi), r32.aim_source,
               STATUS_NAME[r32.solve_status]);
        if (crossed32) {
            printf("%+8.2f mm\n", 1e3 * lat32);
        } else {
            printf("  short\n");
        }
    }
    printf("    %u kept, %u controls.  Kept aims pass at most %.2f mm from the hole centre on the fitted patch; the "
           "aims they replace (rule off) miss by more than the hole radius in %u and do not reach the hole line in "
           "%u of the %u; the aim moves by up to %.0f mrad (%.1f steps of the simulation's display model).\n",
           n_kept, n_ctl, worst_kept_mm, off_misses, off_short, n_kept, worst_move_mrad,
           worst_move_mrad / DISPLAY_STEP_MRAD);
    printf("    single build with the firmware's tolerances and the rule on: aim on the patch (aim_source 0) in %u "
           "of the %u, passing within 5.5 mm in %u (worst of those on the patch %.2f mm)\n",
           single_src0, n_kept, single_holes, worst_single_mm);
    GL_CHECK_EQ(n_kept, 14);
    GL_CHECK_EQ(n_ctl, 4);
    /* what the rule is for: most of the replaced aims do not hole the putt on the patch */
    GL_CHECK(off_misses + off_short >= 9u);
    /* PINNED from this run: the looser tolerances of the single build solve
     * or keep 13 of the 14 on the patch */
    GL_CHECK(single_src0 >= 12u);
    GL_CHECK(single_holes >= 12u);
}

/* A placement as the review's worst-case searches built it. */
static void wc_meas_(gl_vec_meas_t *m, double tilt_x, double tilt_y, double stimp, double bearing, double stereo_m,
                     double dialled_m, double low_elev)
{
    memset(m, 0, sizeof(*m));
    m->f_px = 657.0;
    m->baseline = 0.02;
    m->h_cam = (double)GL_CFG_CAM_AXIS_HEIGHT_M;
    m->tilt[0] = (double)(float)tilt_x;
    m->tilt[1] = (double)(float)tilt_y;
    m->tilt_reads = 1u;
    m->flag_found = 1u;
    m->flag_bearing = (double)(float)bearing;
    m->flag_disparity = (stereo_m > 0.0) ? (double)(float)(657.0 * 0.02 / stereo_m) : GL_VEC_NAN;
    m->flag_low_elev = (double)(float)low_elev;
    m->flag_top_elev = GL_VEC_NAN;
    m->stick_height_est = (double)2.1f;
    m->stick_height_rel_sigma = (double)0.05f;
    m->grain_kappa = 0.0;
    m->grain_azimuth = 0.0;
    m->stimp_ft = stimp;
    m->user_distance = (dialled_m > 0.0) ? (double)(0.01f * (float)floor(dialled_m * 100.0 + 0.5)) : GL_VEC_NAN;
}

/* Review: the costliest estimate is 0.62 million RK4 steps, not 0.5; nothing
 * but loop counters bounds it, and it blocks the main loop.  Two things:
 *   - a patch that IS a plane (flag out, not ranged) was solved a second time
 *     as "its secant plane": the same problem at twice the cost;
 *   - gl_solver_options_t.max_steps: a budget on the work itself. */
GL_TEST(test_step_budget_and_the_plane_solved_once)
{
    gl_vec_meas_t w1, w2;
    gl_vec_est_result_t r, rb, r64;
    const double stimp = 12.5, a_r = 1.83 * 1.83 / (2.0 * stimp * 0.3048), crit = a_r / (5.0 / 7.0 * 9.80665);
    const double b = 0.33910485203911905, sx = -0.89850998513005353 * crit, sy = -0.27816065634007064 * crit;
    const uint32_t budget = 300000u;
    uint32_t worst_vec[2] = { 0u, 0u }, worst_result[2] = { 0u, 0u };
    unsigned differ = 0u, over[2] = { 0u, 0u };

    /* W1: 30 m dialled, down a slope at 0.90 of critical (the safety review's search, seed 21) */
    wc_meas_(&w1, sx * cos(b) - sy * sin(b), sx * sin(b) + sy * cos(b), stimp, b, -1.0, 29.985267577435099,
             0.024216351276332825 - 0.0056 / 29.985267577435099);
    gl_vec32_estimate_meas(&w1, 1u, NULL, NULL, 0u, (double)0.38f, 0.0, 0u, 0, &r);
    printf("    W1, 30 m dialled, down a slope at 0.90 of critical (a tilt-only plane): status %d, aim_source %u, %s, "
           "%lu trial rolls, %lu RK4 steps (the review measured 424 rolls, 619 822 steps: the plane solved twice)\n",
           r.status, r.aim_source, STATUS_NAME[r.solve_status], (unsigned long)r.n_rolls, (unsigned long)r.n_steps);
    GL_CHECK_EQ(r.status, ST_OK);
    GL_CHECK(r.range_missing);
    GL_CHECK_EQ(r.aim_source, 2);
    GL_CHECK_EQ(r.solve_status, 4);
    GL_CHECK(r.n_rolls <= GL_SOLVER_DEFAULT_MAX_ROLLS + 120u); /* ONE aim solve */
    GL_CHECK(r.n_steps > 250000u && r.n_steps < 340000u);
    /* the same record in double: also one solve, and the same class */
    gl_vec64_estimate_meas(&w1, 1u, NULL, NULL, 0u, (double)0.38f, 0.0, 0u, 1, &r64);
    GL_CHECK(r64.n_rolls <= GL_SOLVER_DEFAULT_MAX_ROLLS + 120u);

    /* W2: 26 m by stereo, method B1, a fitted patch (the safety review's search, seed 11) */
    wc_meas_(&w2, 0.0041603158475774019, -0.06771927674515206, 12.0, -0.3758663894382302, 26.014521134960443, -1.0,
             -0.023759670697298448 - 0.0056 / 26.014521134960443);
    gl_vec32_estimate_meas(&w2, 1u, NULL, NULL, 0u, (double)0.64f, 0.0, 0u, 0, &r);
    gl_vec32_estimate_meas(&w2, 1u, NULL, NULL, 0u, (double)0.64f, 0.0, budget, 0, &rb);
    printf("    W2, 26 m by stereo, method B1: without a budget (%u, %s) after %lu rolls and %lu RK4 steps; with a "
           "budget of %lu steps (%u, %s) after %lu rolls and %lu steps\n", r.aim_source, STATUS_NAME[r.solve_status],
           (unsigned long)r.n_rolls, (unsigned long)r.n_steps, (unsigned long)budget, rb.aim_source,
           STATUS_NAME[rb.solve_status], (unsigned long)rb.n_rolls, (unsigned long)rb.n_steps);
    GL_CHECK_EQ(r.status, ST_OK);
    GL_CHECK(r.n_steps > 500000u); /* the costliest estimate anybody found: 0.58 million */
    GL_CHECK(r.n_rolls > GL_SOLVER_DEFAULT_MAX_ROLLS + 120u && r.n_rolls <= 2u * (GL_SOLVER_DEFAULT_MAX_ROLLS + 120u));
    GL_CHECK_EQ(rb.status, ST_OK);
    GL_CHECK(rb.n_steps <= budget + 6004u);
    GL_CHECK(rb.n_steps >= budget);
    GL_CHECK_EQ(rb.aim_source, 2);
    GL_CHECK_EQ(rb.solve_status, 4);
    GL_CHECK(isfinite(rb.phi) && isfinite(rb.v0) && rb.v0 > 0.0 && isfinite(rb.confidence));
    /* the fit is not part of the budget */
    for (int k = 0; k < 5; k++) {
        GL_CHECK(rb.patch[k] == r.patch[k]);
    }
    /* (the double build on the same record: whatever it ends as - near the
     * critical slope the class is not stable between the precisions - it
     * keeps to the budget) */
    gl_vec64_estimate_meas(&w2, 1u, NULL, NULL, 0u, (double)0.64f, 0.0, budget, 1, &r64);
    GL_CHECK(r64.status == ST_OK && r64.n_steps <= budget + 6004u);

    /* a budget of one step: one roll, then the planar first guess of the secant plane */
    gl_vec32_estimate_meas(&w2, 1u, NULL, NULL, 0u, (double)0.64f, 0.0, 1u, 0, &rb);
    printf("    W2 with a budget of 1 step: status %d, (%u, %s), %lu roll(s), %lu steps, aim %+.1f mrad at %.2f m/s\n",
           rb.status, rb.aim_source, STATUS_NAME[rb.solve_status], (unsigned long)rb.n_rolls,
           (unsigned long)rb.n_steps, 1e3 * rb.phi, rb.v0);
    GL_CHECK_EQ(rb.status, ST_OK);
    GL_CHECK(rb.n_steps <= 6004u && rb.n_rolls <= 1u);
    GL_CHECK_EQ(rb.aim_source, 2);
    GL_CHECK_EQ(rb.solve_status, 4);
    GL_CHECK(isfinite(rb.phi) && fabs(rb.phi) <= 0.6 + 1e-6 && isfinite(rb.v0) && rb.v0 > 0.0);

    /* The budget changes nothing where it is not reached: every vector case
     * (both builds) gives the same record with and without it. */
    for (unsigned i = 0; i < gl_vec_n_est; i++) {
        gl_vec_est_result_t a, bb;
        for (int dbl = 0; dbl < 2; dbl++) {
            if (dbl) {
                gl_vec64_set_max_steps(0u);
                gl_vec64_estimate(&gl_vec_est[i], GL_VEC_TOL_CASE, 0, &a);
                gl_vec64_set_max_steps(budget);
                gl_vec64_estimate(&gl_vec_est[i], GL_VEC_TOL_CASE, 0, &bb);
                gl_vec64_set_max_steps(0u);
            } else {
                gl_vec32_set_max_steps(0u);
                gl_vec32_estimate(&gl_vec_est[i], GL_VEC_TOL_DEFAULT, 0, &a);
                gl_vec32_set_max_steps(budget);
                gl_vec32_estimate(&gl_vec_est[i], GL_VEC_TOL_DEFAULT, 0, &bb);
                gl_vec32_set_max_steps(0u);
            }
            worst_vec[dbl] = (a.n_steps > worst_vec[dbl]) ? a.n_steps : worst_vec[dbl];
            if (a.status == ST_OK && a.aim_source <= 1u && a.n_steps > worst_result[dbl]) {
                worst_result[dbl] = a.n_steps; /* the costliest estimate that ENDS WITH A RESULT */
            }
            if (a.n_steps < budget) {
                differ += (memcmp(&a, &bb, sizeof(a)) != 0) ? 1u : 0u;
            } else {
                over[dbl]++;
                GL_CHECK(bb.n_steps <= budget + 6004u);
                GL_CHECK(bb.status == ST_OK);
            }
        }
    }
    printf("    all %u estimator vectors with and without the budget of %lu steps: %u records differ among those "
           "that stay inside it\n      single build, firmware tolerances: costliest %lu steps, costliest with a "
           "result (aim_source 0 or 1) %lu, over the budget %u\n      double build, the reference's 1e-9 m:      "
           "costliest %lu steps, costliest with a result %lu, over the budget %u\n",
           gl_vec_n_est, (unsigned long)budget, differ, (unsigned long)worst_vec[0],
           (unsigned long)worst_result[0], over[0], (unsigned long)worst_vec[1], (unsigned long)worst_result[1],
           over[1]);
    GL_CHECK_EQ(differ, 0);
    /* the firmware's build never needs the budget for a read that has a result */
    GL_CHECK(worst_result[0] < budget);
}

/* Review: absurd but finite inputs whose SQUARES leave the range gave GL_OK
 * (a weight 1 / sigma^2 became 0 or infinite and one range channel silently
 * replaced the fusion, or the fused distance became not-a-number and the
 * read "not ranged" at the 3 m default) where the reference raises
 * OverflowError.  They are refused now: GL_ERR_RANGE, the flagged record. */
GL_TEST(test_absurd_inputs_are_refused)
{
    gl_vec_meas_t m, base;
    gl_vec_est_result_t r;

    memset(&base, 0, sizeof(base));
    base.f_px = 657.0;
    base.baseline = 0.02;
    base.h_cam = 0.0056;
    base.tilt[0] = 0.012;
    base.tilt[1] = -0.018;
    base.tilt_reads = 1u;
    base.flag_found = 1u;
    base.flag_bearing = 0.05;
    base.flag_disparity = 657.0 * 0.02 / 9.76;
    base.flag_low_elev = -0.0005;
    base.flag_base_visible = 1u;
    base.flag_top_visible = 1u; /* both range channels: stereo and the stick's angular height */
    base.flag_top_elev = 0.198;
    base.stick_height_est = 1.96;
    base.stick_height_rel_sigma = 0.07;
    base.stimp_ft = 10.0;
    base.user_distance = GL_VEC_NAN;

    /* the record itself is a good read in both builds */
    gl_vec64_estimate_meas(&base, 1u, NULL, NULL, 0u, 0.30, 0.0, 0u, 0, &r);
    GL_CHECK(r.status == ST_OK && fabs(r.distance - 9.754) < 0.01 && !r.range_missing);
    gl_vec32_estimate_meas(&base, 1u, NULL, NULL, 0u, 0.30, 0.0, 0u, 0, &r);
    GL_CHECK(r.status == ST_OK && fabs(r.distance - 9.754) < 0.01 && !r.range_missing);

    /* double: the reference raises OverflowError for both */
    m = base;
    m.stick_height_rel_sigma = 1e300;
    gl_vec64_estimate_meas(&m, 1u, NULL, NULL, 0u, 0.30, 0.0, 0u, 0, &r);
    printf("    double, stick_height_rel_sigma 1e300: status %d (GL_ERR_RANGE is %d); the review found GL_OK at "
           "9.76 m\n", r.status, (int)GL_ERR_RANGE);
    GL_CHECK_EQ(r.status, GL_ERR_RANGE);
    GL_CHECK(r.distance == 0.0 && r.confidence == 0.0 && r.aim_source == 3u && r.solve_status == 255u);
    m = base;
    m.stick_height_est = 1e300;
    gl_vec64_estimate_meas(&m, 1u, NULL, NULL, 0u, 0.30, 0.0, 0u, 0, &r);
    GL_CHECK_EQ(r.status, GL_ERR_RANGE);

    /* single: the same mechanism at 1e20 / 1e-20 */
    m = base;
    m.stick_height_est = 1e-20;
    gl_vec32_estimate_meas(&m, 1u, NULL, NULL, 0u, 0.30, 0.0, 0u, 0, &r);
    printf("    single, stick height 1e-20 m with a valid stereo range: status %d; the review found GL_OK, \"not "
           "ranged\", 3 m\n", r.status);
    GL_CHECK_EQ(r.status, GL_ERR_RANGE);
    GL_CHECK(r.distance == 0.0 && r.confidence == 0.0 && !r.range_missing);
    m = base;
    m.f_px = 1e20;
    gl_vec32_estimate_meas(&m, 1u, NULL, NULL, 0u, 0.30, 0.0, 0u, 0, &r);
    GL_CHECK_EQ(r.status, GL_ERR_RANGE);
    m = base;
    m.stick_height_rel_sigma = 1e20;
    gl_vec32_estimate_meas(&m, 1u, NULL, NULL, 0u, 0.30, 0.0, 0u, 0, &r);
    GL_CHECK_EQ(r.status, GL_ERR_RANGE);
    /* a large but honest uncertainty is not refused: the stereo channel carries the read */
    m = base;
    m.stick_height_rel_sigma = 1e6;
    gl_vec32_estimate_meas(&m, 1u, NULL, NULL, 0u, 0.30, 0.0, 0u, 0, &r);
    GL_CHECK(r.status == ST_OK && fabs(r.distance - 9.76) < 0.02);
}

/* A read of a 0.71 m putt with a ragged horizon (the numerical reviewer's
 * random case 18370; the inputs are single-precision numbers).  Method B2
 * fits a silhouette offset of 0.25 to it. */
static const double lm_case_az_[41] = {
    -0.33921441435813904, -0.3222537040710449, -0.3052929639816284, -0.2883322536945343,
    -0.2713715434074402, -0.2544108033180237, -0.23745009303092957, -0.22048936784267426,
    -0.20352864265441895, -0.18656793236732483, -0.16960720717906952, -0.1526464819908142,
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    0.33921441435813904,
};
static const double lm_case_elev_[41] = {
    0.13625656068325043, 0.14582544565200806, 0.15591326355934143, 0.1667328029870987,
    0.17399203777313232, 0.18480171263217926, 0.19111713767051697, 0.2056199014186859,
    0.21807269752025604, 0.22482721507549286, 0.2359381467103958, 0.24371857941150665,
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    0.40628960728645325,
};
static const gl_vec_meas_t lm_case_meas_ = {
    .f_px = 670.6603393554688, .baseline = 0.019999999552965164, .h_cam = 0.005200000014156103, .tilt = { -0.0018872296204790473, 0.0027647956740111113 },
    .tilt_reads = 2, .flag_found = 1, .flag_base_visible = 1, .flag_top_visible = 0,
    .flag_bearing = -0.09991660714149475, .flag_disparity = 18.456220626831055, .flag_low_elev = 0.0012588519603013992, .flag_top_elev = GL_VEC_NAN,
    .stick_height_est = 1.9416768550872803, .stick_height_rel_sigma = 0.019999999552965164, .n_horizon = 41, .horizon_first = 0,
    .grain_kappa = 0.0, .grain_azimuth = 0.6735798716545105, .stimp_ft = 10.138413429260254, .user_distance = GL_VEC_NAN
};

/* Review: in single precision a horizon fit that HAD converged was reported
 * "not converged" (60 iterations of an equal-cost flip-flop between two
 * neighbouring numbers) whenever a fitted parameter was so large that its
 * spacing exceeded the convergence tolerance: here the silhouette offset,
 * 0.25, whose neighbours are 3e-8 apart = 3e-5 in the scaled units of
 * lm_tol = 1e-5.  The application then showed "FIT NOT DONE" and took 0.7 of
 * the confidence. */
GL_TEST(test_horizon_fit_converges_at_the_resolution_of_its_parameters)
{
    gl_vec_est_result_t r32, r64;
    gl_vec32_estimate_meas(&lm_case_meas_, 1u, lm_case_az_, lm_case_elev_, 2u, 0.30, 0.0, 0u, 0, &r32);
    gl_vec64_estimate_meas(&lm_case_meas_, 1u, lm_case_az_, lm_case_elev_, 2u, 0.30, 0.0, 0u, 1, &r64);
    printf("    horizon fit, silhouette offset 0.25: single precision converged %u after %lu iterations (the "
           "review: not converged, 60); double with the same tolerances converged %u after %lu; patch d %.8f / "
           "%.8f, e %.8f / %.8f\n", r32.fit_converged, (unsigned long)r32.n_iter, r64.fit_converged,
           (unsigned long)r64.n_iter, r32.patch[3], r64.patch[3], r32.patch[4], r64.patch[4]);
    GL_CHECK(r32.status == ST_OK && r64.status == ST_OK);
    GL_CHECK(r32.used_horizon && r64.used_horizon);
    GL_CHECK(r64.fit_converged);
    GL_CHECK(r32.fit_converged);
    GL_CHECK(r32.n_iter <= 20u);
    GL_CHECK_NEAR(r32.patch[3], r64.patch[3], 2e-7);
    GL_CHECK_NEAR(r32.patch[4], r64.patch[4], 2e-7);
    /* the double build is not touched by the change: 9 iterations, as the review traced */
    GL_CHECK_EQ(r64.n_iter, 9);
}

/* Review: the margins quoted for the single-precision tolerances (tol_miss =
 * 10 x the roll noise) were measured on the putts of the reference vectors
 * (up to 12 m, pace 0.15 m and more).  The roll noise grows with the length
 * of the roll and as the ball dies at the hole.  Planes with slopes up to
 * 0.6 of critical, paces 0.05 to 0.9 m: the tight double solution is rolled
 * in single and in double precision, by distance. */
GL_TEST(test_single_precision_roll_noise_by_distance)
{
    static const double lo[4] = { 0.3, 6.0, 15.0, 25.0 }, hi[4] = { 6.0, 15.0, 25.0, 40.0 };
    static const double paces[5] = { 0.05, 0.15, 0.30, 0.45, 0.90 };
    static samples_t lat;
    const double tol_miss = (double)GL_SOLVER_SINGLE_TOL_MISS_M;
    double max_by_bin[4];
    unsigned above[4];

    lcg_ = 20261113u;
    printf("    |single - double| lateral position at the hole line of the same launch, by putt length "
           "(tol_miss %.0e m):\n", tol_miss);
    for (int bin = 0; bin < 4; bin++) {
        unsigned n_launch = 0u;
        double med, p99;
        lat.n = 0u;
        above[bin] = 0u;
        for (int k = 0; k < 700; k++) {
            gl_vec_sol_case_t c;
            gl_vec_sol_result_t s;
            const double stimp = 7.0 + 7.0 * lcg_uniform_();
            const double a_r = 1.83 * 1.83 / (2.0 * stimp * 0.3048);
            const double crit = a_r / (5.0 / 7.0 * 9.80665);
            const double mag = 0.6 * crit * sqrt(lcg_uniform_());
            const double az = 2.0 * PI * lcg_uniform_();
            double c64[5], g64[2] = { 0.0, 0.0 }, l32, s32, l64, s64;
            memset(&c, 0, sizeof(c));
            c.coeffs[0] = (double)(float)(mag * cos(az));
            c.coeffs[1] = (double)(float)(mag * sin(az));
            c.distance = (double)(float)(lo[bin] + (hi[bin] - lo[bin]) * lcg_uniform_());
            c.stimp_ft = stimp;
            c.a_r = (double)(float)a_r;
            c.past = paces[(int)(5.0 * lcg_uniform_()) % 5];
            c.tol_miss = 1e-9;
            c.tol_pace = 1e-9;
            c.max_rolls = 1000u;
            gl_vec64_solve(&c, GL_VEC_TOL_CASE, &s);
            if (s.status != ST_OK || s.solve_status != 0u) {
                continue;
            }
            memcpy(c64, c.coeffs, sizeof(c64));
            /* both kernels are given the launch as a single-precision number */
            if (gl_vec32_roll_patch(c64, c.distance, c.a_r, g64, (double)(float)s.phi, (double)(float)s.v0, &l32,
                                    &s32) &&
                gl_vec64_roll_patch(c64, c.distance, c.a_r, g64, (double)(float)s.phi, (double)(float)s.v0, &l64,
                                    &s64)) {
                add_(&lat, fabs(l32 - l64));
                above[bin] += (fabs(l32 - l64) > tol_miss / 5.0) ? 1u : 0u;
                n_launch++;
            }
        }
        max_by_bin[bin] = summarise_(&lat, &med, &p99);
        printf("      %4.1f to %4.1f m: %3u launches, median %.1e m, 99 %% %.1e m, max %.2e m = %.2f x tol_miss; "
               "above tol_miss / 5 in %u\n", lo[bin], hi[bin], n_launch, med, p99, max_by_bin[bin],
               max_by_bin[bin] / tol_miss, above[bin]);
        GL_CHECK(n_launch > 300u);
    }
    /* up to 6 m the stated margin holds: the noise is below a fifth of the tolerance */
    GL_CHECK(max_by_bin[0] * 5.0 <= tol_miss);
    GL_CHECK_EQ(above[0], 0);
    /* NOT MET beyond: PINNED with what this run measures.  From 15 m on the
     * worst launch differs by MORE than a fifth of the tolerance (beyond 25 m
     * by more than the tolerance itself): there the tolerance is inside the
     * noise of the roll, and a solve can end NO_CONVERGENCE for no other
     * reason.  (A tolerance that grows with the distance would be a change
     * of the solver's contract: open issue, README.) */
    printf("    the margin \"tol_miss = 5 x the roll noise\" is asserted up to 6 m and holds up to 15 m in this run;\n"
           "    NOT MET from 15 m on (pinned: see the figures above)\n");
    GL_CHECK(max_by_bin[1] <= 4.0 * tol_miss);
    GL_CHECK(max_by_bin[2] * 5.0 > tol_miss);
    GL_CHECK(max_by_bin[3] * 5.0 > tol_miss);
    GL_CHECK(max_by_bin[3] <= 20.0 * tol_miss);
}

int main(void)
{
    GL_RUN(test_api_and_sizes);
    GL_RUN(test_double_reproduces_every_estimator_vector);
    GL_RUN(test_double_reproduces_every_solver_vector);
    GL_RUN(test_double_reproduces_every_roll_vector);
    GL_RUN(test_single_precision_roll_kernel);
    GL_RUN(test_single_precision_estimator_deviation);
    GL_RUN(test_single_precision_fallback_cases);
    GL_RUN(test_single_precision_solver_deviation);
    GL_RUN(test_vectors_reach_every_aim_source_and_status);
    GL_RUN(test_hostile_inputs_give_defined_results);
    GL_RUN(test_rolls_and_steps_are_bounded);
    GL_RUN(test_near_miss_cases);
    GL_RUN(test_step_budget_and_the_plane_solved_once);
    GL_RUN(test_absurd_inputs_are_refused);
    GL_RUN(test_horizon_fit_converges_at_the_resolution_of_its_parameters);
    GL_RUN(test_single_precision_roll_noise_by_distance);
    return gl_test_summary();
}
